// SPDX-License-Identifier: (GPL-2.0+ OR MIT)
/*
 * Copyright (c) 2020 Rockchip Electronics Co., Ltd.
 *
 *
 */

 /dts-v1/;

#include "rk3568-lubancat-2io.dtsi"

/ {
	model = "LubanCat-2IO HDMI+EDP";
	compatible = "rockchip,rk3568-lubancat-2io-edp", "rockchip,rk3568";
};
