/*
 * Copyright (C) 2022 - All Rights Reserved by
 * EmbedFire LubanCat
 */

/dts-v1/;
/plugin/;

#include <dt-bindings/gpio/gpio.h>
#include <dt-bindings/pinctrl/rockchip.h>
#include <dt-bindings/clock/rk3568-cru.h>


/ {
	fragment@0 {
		target = <&uart3>;

		__overlay__ {
			status = "okay";
			pinctrl-names = "default";
			pinctrl-0 = <&uart3m1_xfer>;
		};
	};
};

