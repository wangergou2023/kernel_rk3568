/dts-v1/;
/plugin/;
#include <dt-bindings/clock/rk3568-cru.h>

/ {
	compatible = "rockchip,rk3568";

	fragment@0 {
		target = <&can1>;

		__overlay__ {
			status = "okay";
			compatible = "rockchip,can-1.0";
			pinctrl-names = "default";
        	pinctrl-0 = <&can1m1_pins>;
		};
	};
};