// SPDX-License-Identifier: (GPL-2.0+ OR MIT)
/*
 * Copyright (c) 2020 Rockchip Electronics Co., Ltd.
 *
 */

/dts-v1/;

#include "rk3568-lubancat2.dts"
#include "rk3568-lubancat-mipi-dsi0-ebf410125_720p.dtsi"

/ {
    model = "EmbedFire LubanCat2 HDMI+MIPI";
    compatible = "embedfire,lubancat2", "rockchip,rk3568";

};
