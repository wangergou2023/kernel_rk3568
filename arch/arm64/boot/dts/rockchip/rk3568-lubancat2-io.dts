// SPDX-License-Identifier: (GPL-2.0+ OR MIT)
/*
 * Copyright (c) 2020 Rockchip Electronics Co., Ltd.
 *
 */

/dts-v1/;

#include "rk3568-lubancat2-io.dtsi"
//#include "rk3568-lubancat2-io-cam.dtsi"

/ {
	model = "LubanCat2-IO HDMI";
	compatible = "rockchip,rk3568-lubancat2-io", "rockchip,rk3568";
};

&route_hdmi {
	status = "okay";
	connect = <&vp0_out_hdmi>;
};
