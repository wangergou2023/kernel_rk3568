// SPDX-License-Identifier: (GPL-2.0+ OR MIT)
/*
 * Copyright (c) 2020 Rockchip Electronics Co., Ltd.
 *
 */

/dts-v1/;

#include "rk3568-lubancat-dev.dtsi"
#include "rk3568-lubancat-dev-cam.dtsi"

/ {
    model = "LubanCat-RK3568 HDMI";
    compatible = "rockchip,rk3568-lubancat-dev", "rockchip,rk3568";

};

&route_hdmi {
    status = "okay";
    connect = <&vp0_out_hdmi>;
};
